// SPDX-License-Identifier: GPL-2.0-only
/*
 * Copyright (C) 2022 Robert Nelson <robertcnelson@gmail.com>
 */

/dts-v1/;
/plugin/;

/*
 * Helper to show loaded overlays under: /proc/device-tree/chosen/overlays/
 */
&{/chosen} {
	overlays {
		BB-I2C2-BME280.kernel = "Tue Dec 30 15:30:00 2025";
	};
};

&i2c2 {
	status = "okay";

	clock-frequency = <100000>;

	#address-cells = <1>;
	#size-cells = <0>;

	bme280@76 {
		status = "okay";
		compatible = "bosch,bme280";
		reg = <0x76>;
	};
};